VERSION ""

NS_ :

BS_:

BU_: Charger Display

BO_ 1288 TemperatureBlock: 8 Charger
 SG_ RearTemp : 48|16@1- (0.1,0) [-3276.8|3276.7] "degC" Display
 SG_ FrontTemp : 0|16@1- (0.1,0) [-3276.8|3276.7] "degC" Display

BO_ 2566844148 ChargerStatus: 8 Charger
 SG_ ChargerOutputCurrentSustainedLim : 0|8@1+ (1,0) [0|255] "" Display

BO_ 3221225472 VECTOR__INDEPENDENT_SIG_MSG: 0 Vector__XXX
 SG_ UnusedSpare : 0|8@1+ (1,0) [0|255] "" Vector__XXX

CM_ BO_ 3221225472 "This is a message for not used signals, created by Vector CANdb++ DBC OLE DB Provider.";
CM_ SG_ 3221225472 UnusedSpare "kept by CANdb++, not on the bus";
CM_ SG_ 1288 FrontTemp "front sensor";
BA_DEF_ BO_  "GenMsgCycleTime" INT 0 65535;
BA_DEF_ SG_  "SystemSignalLongSymbol" STRING ;
BA_DEF_DEF_  "GenMsgCycleTime" 100;
BA_DEF_DEF_  "SystemSignalLongSymbol" "";
BA_ "SystemSignalLongSymbol" SG_ 2566844148 ChargerOutputCurrentSustainedLim "ChargerOutputCurrentSustainedLimitLevel";
