VERSION ""

NS_ :

BS_:

BU_: VCU BMS

BO_ 291 EngineData: 8 VCU
 SG_ EngineState : 24|4@1+ (1,0) [0|15] "" BMS
 SG_ VehicleSpeed : 0|16@1+ (0.1,0) [0|250] "km/h" BMS

CM_ BO_ 291 "Engine cyclic data";
CM_ SG_ 291 VehicleSpeed "Wheel-based vehicle speed";
VAL_ 291 EngineState 0 "Off" 1 "Cranking" 2 "Running" ;
BA_DEF_ BO_  "GenMsgCycleTime" INT 0 65535;
BA_DEF_DEF_  "GenMsgCycleTime" 0;
BA_ "GenMsgCycleTime" BO_ 291 10;
